## Documentation/devicetree/bindings/display/panel/samsung,s6e3hc3-amb670yf07.yaml
```yaml
# SPDX-License-Identifier: GPL-2.0-only OR BSD-2-Clause
%YAML 1.2
---
$id: http://devicetree.org/schemas/display/panel/samsung,s6e3hc3-amb670yf07.yaml#
$schema: http://devicetree.org/meta-schemas/core.yaml#

title: Samsung AMB670YF07 AMOLED DSI panel with the S6E3HC3 DDIC

description: The AMB670YF07 is a 1440x3216 command-mode AMOLED panel from
  Samsung Mobile Displays (SMD), found in the OnePlus 10 Pro. It takes a
  DSC-compressed stream over 4 DSI lanes.

maintainers:
  - Uriel Curiel <kratoz.00616@gmail.com>

allOf:
  - $ref: panel-common.yaml#

properties:
  compatible:
    const: samsung,s6e3hc3-amb670yf07

  reg:
    maxItems: 1

  vddio-supply:
    description: I/O voltage rail, 1.8 V

  vci-supply:
    description: Analog voltage rail, 3.0 V

  enable-gpios:
    maxItems: 1
    description: Enables the panel's ELVDD/ELVSS supply

required:
  - compatible
  - reg
  - reset-gpios
  - enable-gpios
  - vddio-supply
  - vci-supply
  - port

unevaluatedProperties: false

examples:
  - |
    #include <dt-bindings/gpio/gpio.h>

    dsi {
        #address-cells = <1>;
        #size-cells = <0>;

        panel@0 {
            compatible = "samsung,s6e3hc3-amb670yf07";
            reg = <0>;
            vddio-supply = <&vreg_l12c_1p8>;
            vci-supply = <&vreg_l13c_3p0>;
            reset-gpios = <&tlmm 3 GPIO_ACTIVE_LOW>;
            enable-gpios = <&tlmm 90 GPIO_ACTIVE_HIGH>;

            port {
                panel_in: endpoint {
                    remote-endpoint = <&mdss_dsi0_out>;
                };
            };
        };
    };

...
```

## Documentation/devicetree/bindings/input/oneplus,mxm1120-alert-slider.yaml
```yaml
# SPDX-License-Identifier: (GPL-2.0-only OR BSD-2-Clause)
%YAML 1.2
---
$id: http://devicetree.org/schemas/input/oneplus,mxm1120-alert-slider.yaml#
$schema: http://devicetree.org/meta-schemas/core.yaml#

title: OnePlus alert slider on two MagnaChip MXM1120 Hall sensors

maintainers:
  - Uriel Curiel <kratoz.00616@gmail.com>

description:
  The three-position alert slider of some OnePlus phones carries a magnet
  past two MXM1120 Hall sensors on one I2C bus, one near each end of its
  travel. The position follows from the difference of the two readings.
  The node describes both sensors, the one near the top first.

properties:
  compatible:
    const: oneplus,mxm1120-alert-slider

  reg:
    items:
      - description: I2C address of the sensor near the top
      - description: I2C address of the sensor near the bottom

  reg-names:
    items:
      - const: up
      - const: down

  interrupts:
    items:
      - description: interrupt of the sensor near the top
      - description: interrupt of the sensor near the bottom

  interrupt-names:
    items:
      - const: up
      - const: down

  vdd-supply:
    description: analog supply of both sensors, 2.7 to 3.6 V

  vio-supply:
    description: digital interface supply of both sensors, 1.65 V to VDD

required:
  - compatible
  - reg
  - reg-names
  - interrupts
  - interrupt-names
  - vdd-supply
  - vio-supply

additionalProperties: false

examples:
  - |
    #include <dt-bindings/interrupt-controller/irq.h>

    i2c {
        #address-cells = <1>;
        #size-cells = <0>;

        alert-slider@d {
            compatible = "oneplus,mxm1120-alert-slider";
            reg = <0x0d>, <0x0c>;
            reg-names = "up", "down";
            interrupts-extended = <&tlmm 117 IRQ_TYPE_EDGE_FALLING>,
                                  <&tlmm 71 IRQ_TYPE_EDGE_FALLING>;
            interrupt-names = "up", "down";
            vdd-supply = <&vreg_l7c_3p0>;
            vio-supply = <&vreg_s10b_1p8>;
        };
    };
```

## Documentation/devicetree/bindings/input/touchscreen/syna,s3908.yaml
```yaml
# SPDX-License-Identifier: GPL-2.0-only OR BSD-2-Clause
%YAML 1.2
---
$id: http://devicetree.org/schemas/input/touchscreen/syna,s3908.yaml#
$schema: http://devicetree.org/meta-schemas/core.yaml#

title: Synaptics TouchComm SPI and I2C touchscreen controllers

description:
  Synaptics touchscreen controllers that use the TouchComm protocol over
  SPI or I2C, such as the S3908 found in the Google Pixel 7 Pro (SPI) and
  the OnePlus 10 Pro (I2C). The sensor size is read from the controller;
  the touchscreen-* properties only adjust it.

maintainers:
  - Derek Ross <derekross@gmail.com>

allOf:
  - $ref: touchscreen.yaml#
  - $ref: /schemas/spi/spi-peripheral-props.yaml#

properties:
  compatible:
    const: syna,s3908

  reg:
    maxItems: 1

  interrupts:
    description: ATTN line, active low
    maxItems: 1

  reset-gpios:
    maxItems: 1

  vdd-supply:
    description: 1.8 V digital and I/O supply

  avdd-supply:
    description: Analog supply, 3.0 to 3.3 V

  spi-max-frequency: true
  touchscreen-inverted-x: true
  touchscreen-inverted-y: true
  touchscreen-size-x: true
  touchscreen-size-y: true
  touchscreen-swapped-x-y: true
  touchscreen-x-mm: true
  touchscreen-y-mm: true

additionalProperties: false

required:
  - compatible
  - reg
  - interrupts
  - reset-gpios

examples:
  - |
    #include <dt-bindings/interrupt-controller/irq.h>
    #include <dt-bindings/gpio/gpio.h>
    spi {
      #address-cells = <1>;
      #size-cells = <0>;

      touchscreen@0 {
        compatible = "syna,s3908";
        reg = <0>;
        interrupt-parent = <&gpa7>;
        interrupts = <0 IRQ_TYPE_LEVEL_LOW>;
        reset-gpios = <&gpp23 2 GPIO_ACTIVE_LOW>;
        vdd-supply = <&ts_vdd>;
        avdd-supply = <&ts_avdd>;
        spi-max-frequency = <10000000>;
        touchscreen-x-mm = <71>;
        touchscreen-y-mm = <154>;
      };
    };

  - |
    #include <dt-bindings/interrupt-controller/irq.h>
    #include <dt-bindings/gpio/gpio.h>

    i2c {
      #address-cells = <1>;
      #size-cells = <0>;

      touchscreen@4b {
        compatible = "syna,s3908";
        reg = <0x4b>;
        interrupts-extended = <&tlmm 21 IRQ_TYPE_LEVEL_LOW>;
        reset-gpios = <&tlmm 20 GPIO_ACTIVE_LOW>;
        vdd-supply = <&ts_vdd_1p8>;
        avdd-supply = <&vreg_l3c_3p0>;
        touchscreen-x-mm = <70>;
        touchscreen-y-mm = <154>;
      };
    };
```
